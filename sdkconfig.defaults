## sdkconfig.defaults
```kconfig
# Enable external RAM (PSRAM)
CONFIG_ESP32S3_SPIRAM_SUPPORT=y
CONFIG_SPIRAM=y
CONFIG_SPIRAM_MODE_OCT=y
CONFIG_SPIRAM_SPEED_80M=y
CONFIG_SPIRAM_USE_MEMMAP=y
CONFIG_SPIRAM_ALLOW_STACK_EXTERNAL_MEMORY=y
```
